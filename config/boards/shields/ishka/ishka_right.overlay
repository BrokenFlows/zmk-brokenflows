#include "ishka.dtsi"

&default_transform {
	col-offset = <5>;
};

&kscan0 {
	col-gpios
		= <&pro_micro_d 6  GPIO_ACTIVE_HIGH>
		, <&pro_micro_d 5  GPIO_ACTIVE_HIGH>
		, <&pro_micro_d 4  GPIO_ACTIVE_HIGH>
		, <&pro_micro_d 3  GPIO_ACTIVE_HIGH>
		, <&pro_micro_d 2  GPIO_ACTIVE_HIGH>
		;
};

