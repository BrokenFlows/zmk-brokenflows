## config/boards/shields/ishka/Kconfig.defconfig
```kconfig
if SHIELD_ISHKA_LEFT

config ZMK_KEYBOARD_NAME
    default "Ishka"

config ZMK_SPLIT_BLE_ROLE_CENTRAL
    default y

endif

if SHIELD_ISHKA_RIGHT

config ZMK_KEYBOARD_NAME
    default "Ishka Right"

endif

if SHIELD_ISHKA_LEFT || SHIELD_ISHKA_RIGHT

config ZMK_SPLIT
    default y

endif
```

## config/boards/shields/ishka/Kconfig.shield
```kconfig
config SHIELD_ISHKA_LEFT
    def_bool $(shields_list_contains,ishka_left)

config SHIELD_ISHKA_RIGHT
    def_bool $(shields_list_contains,ishka_right)
```
